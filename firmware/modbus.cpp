// ---------------- modbus ----------------------------------------

#include "modbus.h"

uint16_t reg[MAX_REG]={0};

void setup_modbus(){
  SerialUSB.begin(115200);
  pinMode(PIN_MB_LED, OUTPUT);
  digitalWrite(PIN_MB_LED, LOW);

} // setup_modbus

char* max(char *a, char*b){
if (a<b) return b; else return a;
} // min

uint32_t MBword(char *a){
  return (*a << 8) | *(a+1);
}

void wordMB(uint32_t w, char *a){
  *a=w >> 8;
  a++;
  *a=w & 0xFF;
}

bool ReadByteUSB(char* a){
  if (SerialUSB.available()){
    *a=SerialUSB.read();
    return true;
  }
  return false;
} // ReadByteUSB

bool Sz(char a){
  return (((a>=1) && (a<=6)) || (a==8) || (a==15) || (a==16));
}

// -------------- crc modbus ---------------------------------------------------

// ---------------------- Modbus Checksum --------------------------------------

uint16_t modbus_crc(char *a, int len){
  //  Table of CRC values for high-order byte:
  static const unsigned char Modbus_auchCRCHi[256] = {
  0x00,0xC1,0x81,0x40,0x01,0xC0,0x80,0x41,0x01,0xC0,0x80,0x41,0x00,0xC1,0x81,0x40,
  0x01,0xC0,0x80,0x41,0x00,0xC1,0x81,0x40,0x00,0xC1,0x81,0x40,0x01,0xC0,0x80,0x41,
  0x01,0xC0,0x80,0x41,0x00,0xC1,0x81,0x40,0x00,0xC1,0x81,0x40,0x01,0xC0,0x80,0x41,
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  0x00,0xC1,0x81,0x40,0x01,0xC0,0x80,0x41,0x01,0xC0,0x80,0x41,0x00,0xC1,0x81,0x40};
  // Table of CRC values for low-order byte:
  static const unsigned char Modbus_auchCRCLo[256] = {
  0x00,0xC0,0xC1,0x01,0xC3,0x03,0x02,0xC2,0xC6,0x06,0x07,0xC7,0x05,0xC5,0xC4,0x04,
  0xCC,0x0C,0x0D,0xCD,0x0F,0xCF,0xCE,0x0E,0x0A,0xCA,0xCB,0x0B,0xC9,0x09,0x08,0xC8,
  0xD8,0x18,0x19,0xD9,0x1B,0xDB,0xDA,0x1A,0x1E,0xDE,0xDF,0x1F,0xDD,0x1D,0x1C,0xDC,
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  0x44,0x84,0x85,0x45,0x87,0x47,0x46,0x86,0x82,0x42,0x43,0x83,0x41,0x81,0x80,0x40};

  unsigned char uchCRCHi=0xFF, uchCRCLo=0xFF;
  int uIndex,p;
  for (p=0; p<len; p++) {
    uIndex=(uchCRCHi ^ a[p]);
    uchCRCHi=(uchCRCLo ^ Modbus_auchCRCHi[uIndex]);
    uchCRCLo=Modbus_auchCRCLo[uIndex];
  }
  return((uchCRCHi<<8)|uchCRCLo);
} // modbus_crc

bool Modbus_chkCRC(char *a, int len){
  return (MBword(&a[len-2])==modbus_crc(a, len-2));
} // Modbus_chkCRC

void delCahrs(char *a, char **pa, int anz){
  *pa=max(a, *pa-anz);
  for (char* p=a; p<*pa; p++) *p=*(p+anz);
} // delChars

void setReg(uint16_t aReg, uint16_t aWert){
  if ((aReg<REG_AD0) && (reg[aReg]!=aWert)){
    reg[aReg]=aWert;
  }
} // setReg

void WorkModbus(){
  static char a[255], *pa=a;
  static int led_timer=0;
  char c;
  uint16_t SollLen,ServerAdr,RegAdr,Nreg,Nbyte,Ikanal;
  if (ReadByteUSB(&c)){
    *pa++=c;
    while ((pa-a>=8) && !Sz(a[1])) delCahrs(a,&pa,1);
    if (pa-a>=8){
      if ((a[1]==15) || (a[1]==16)) SollLen=a[6]+9; else SollLen=8;
      if (pa-a>=SollLen){ 
        if (Modbus_chkCRC(a, SollLen)) {
          digitalWrite(PIN_MB_LED, HIGH);
          led_timer=100;
          ServerAdr=a[0];
          if ((ServerAdr==0) || (ServerAdr==MODBUS_ADR)){
            char r[255], *pr=r;
            RegAdr=MBword(&a[2]);
            Nreg=MBword(&a[4]);
            switch (a[1]){
              case 1:
              case 2: // DI
                Nbyte=(Nreg+7) / 8;
                *pr++=a[0];
                *pr++=a[1]; 
                *pr++=Nbyte;
                for (int n=0; n<Nbyte; n++) *pr++=0;
                break;
              case 3:
              case 4: // WI
                Nreg=min(Nreg,(uint16_t)124);
                Nbyte=Nreg*2;
                Ikanal=RegAdr;
                *pr++=a[0];
                *pr++=a[1];
                *pr++=Nbyte;
                for (int n=0; n<Nreg; n++){
                  if (Ikanal<MAX_REG) wordMB(reg[Ikanal], pr); else wordMB(0, pr);
                  Ikanal++;
                  pr+=2;
                }
                break;
              case 5: // DO single
                // RegAdr, Bitwert in Nreg
                for (int n=0; n<6; n++) *pr++=a[n];
                break;
              case 6: // WO single
                setReg(RegAdr, Nreg); // Nr, Wert
                for (int n=0; n<6; n++) *pr++=a[n];
                break;
              case 8: 
                for (int n=0; n<6; n++) *pr++=a[n];
                break;
              case 15: // DO multiple
                for (int n=0; n<6; n++) *pr++=a[n];
                break;
              case 16: // WO multiple
                Nreg=min(Nreg, (uint16_t)(a[6] / 2));
                Ikanal=RegAdr;
                pa=&a[7];
                for (int n=0; n<Nreg; n++){
                  setReg(Ikanal, MBword(pa)); // Nr, Wert
                  Ikanal++;
                  pa+=2;
                }
                for (int n=0; n<6; n++) *pr++=a[n];
                break;
            }
            if ((ServerAdr>0) && (pr>r)){ // 0=Broadcast: bearbeiten und nicht antworten
              wordMB(modbus_crc(r, pr-r), pr);
              pr+=2;
              SerialUSB.write(r, pr-r);
            }
          } // if ServerAdr ...
          delCahrs(a,&pa,SollLen);
        } else delCahrs(a,&pa,1);
      } // if pa-a>=SollLen
    } // if pa-a>=8
  } // if ReadByteUSB(&c)
  if (led_timer){
    led_timer--;
    if (!led_timer) digitalWrite(PIN_MB_LED, LOW);
  }
} // WorkModbus

